## Documentation/devicetree/bindings/xlnx,v-hdmi-rx-ss.txt
```
Xilinx HDMI RX Subsystem

The Xilinx HDMI RX Subsystem contains several subcores to implement
a HDMI receiver. media/platform/xilinx/xilinx-hdmi-rx.c implements a
V4L2 video-capture sub-device for the Xilinx Video IP Pipeline device
(xilinx-vipp).

There are 2 optional HDCP cores that can be included in the IP configuration.
Below provided sample device tree depicts the configuration when both cores are 
included. If an optional core is included then corresponding entries for the 
core parameters must be included in the device tree

Note: If HDCP cores are included in the design, the user must provide valid
	  HDCP keys for the encryption to work. 

Refer to xlnx,vphy.txt for the phy specifics.

Required Properties:
 - compatible: Should be "xlnx,v-hdmi-rx-ss-2.0".
 - reg: Base address and size of the IP core and hdcp1x key management block
 - reg-names: Identification string for included register blocks
		"hdmi-rxss": Identification string for hdmirx subsystem. Always present
		"hdcp1x-keymngmt": Identification string for Key management block for
			hdcp1x. [Optional]
 - interrupts-parent: phandle for interrupt controller.
 - interrupts: Interrupt numbers for mandatory and optional blocks
 - interrupt-names: Identification string that binds irq number to block 
		generating the interrupt
		"hdmirx": interrupt for rx subcore [always present]
		"hdcp1x": interrupt for hdcp1.4 core [optional]
		"hdcp1x-timer": interrupt for hdcp1.4 timer [present if hdcp1x is 
			included]
		"hdcp22": interrupt for hdcp22 core [optional]
		"hdcp22-timer": interrupt for hdcp2.2 timer [present if hdcp22 is
			included]
		
 - clocks: phandle for axi-lite, video stream
 - clock-names: The identification string, "axi-lite", is always required for
                the axi-lite clock, "video" is always required for video stream
				clock
   
 - phys: phandle for phy lanes registered for hdmi protocol. HDMI always 
         require 3 lanes
 - phy-names: The identification string, "hdmi-phy0" and so on
 
 - xlnx,input-pixels-per-clock: IP configuration for samples/clk (2, 4)
         Note: Only 2 is supported at this time
 - xlnx,max-bits-per-component: The data width per video component (8,10,12,16)
         Note: Only 8 is supported at this time
 - xlnx,edid-ram-size: Denotes amount of BRAM allocated for EDID in IP 
 - xlnx,hdmi-rx-offset: Relative offset of rx core within the subsystem
 - xlnx,hdcp22-rx-offset: Relative offset of optional hdcp22 core within the
		subsystem. If present indicates inclusion of the optional core
 - xlnx,hdcp22-cipher-offset: Relative offset of hdcp22 cipher within the 
		subsystem. Must be present if hdcp22 is included
 - xlnx,hdcp22-mmult-offset: Relative offset of hdcp22 multiplier within the
		subsystem. Must be present if hdcp22 is included
 - xlnx,hdcp22-timer-offset: Relative offset of hdcp22 timer within the
		subsystem. Must be present if hdcp22 is included
 - xlnx,hdcp22-rng-offset: Relative offset of rng core within the
		subsystem. Must be present if hdcp22 is included	
 - xlnx,hdcp1x-offset: Relative offset of optional hdcp1x core within the
		subsystem. If present indicates inclusion of the optional core 
 - xlnx,hdcp1x-timer-offset: Relative offset of hdcp1x timer within the
		subsystem. Must be present if hdcp1x is included

 - ports: Video ports, using the DT bindings defined in ../video-interfaces.txt.
          The Rx only has an output port (0).
 
==Example==
 
	hdmi_input_v_hdmi_rx_ss_0: v_hdmi_rx_ss@a0000000 {
		compatible = "xlnx,v-hdmi-rx-ss-2.0";
		reg = <0x0 0xa0000000 0x0 0x100000>, <0x0 0xa0270000 0x0 0x10000>;
		reg-names = "hdmi-rxss", "hdcp1x-keymngmt";	
		interrupt-parent = <&gic>;
		interrupts = <0 91 4>, <0 108 4>, <0 109 4>, <0 110 4>, <0 111 4>;
		interrupt-names = "hdmirx", "hdcp1x", "hdcp1x-timer", "hdcp22", "hdcp22-timer";
		clocks = <&vid_s_axi_clk>, <&vid_stream_clk>;
		clock-names = "axi-lite", "video";
		phy-names = "hdmi-phy0", "hdmi-phy1", "hdmi-phy2";
		phys = <&vphy_lane0 0 1 1 0>, <&vphy_lane1 0 1 1 0>, <&vphy_lane2 0 1 1 0>;
	
		xlnx,input-pixels-per-clock = <0x2>;
		xlnx,max-bits-per-component = <0x8>;
		xlnx,edid-ram-size = <0x100>;
		
		/* offset of HDMI RX within the HDMI RXSS */
		xlnx,hdmi-rx-offset = <0x90000>;
	
		/* HDCP22 is a subsystem within the HDMI RXSS at this offset */
		xlnx,hdcp22-rx-offset = <0x40000>;
		/* and so the HDCP22 subcomponent offsets are relative to xlnx,hdcp22-rx-offset */
		xlnx,hdcp22-cipher-offset = <0x00000>;
		xlnx,hdcp22-mmult-offset = <0x10000>;
		xlnx,hdcp22-timer-offset = <0x20000>;
		xlnx,hdcp22-rng-offset = <0x30000>;
	
		/* HDCP14 is NOT a subsystem (currently), so these are relative to RXSS reg base */
		xlnx,hdcp1x-timer-offset = <0x00000>;
		xlnx,hdcp1x-offset = <0x80000>;

		ports {
			#address-cells = <1>;
			#size-cells = <0>;
			port@0 {
				reg = <0>;
	
				/* HDMI RX SS -> FB-WR */
				hdmi_rxss_out: endpoint {
					remote-endpoint = <&vcap_hdmi_in>;
				};
			};
		};			
	};
```

## Documentation/devicetree/bindings/xlnx,v-hdmi-tx-ss.txt
```
Xilinx HDMI TX Subsystem

The Xilinx HDMI TX Subsystem contains several subcores to implement
a HDMI receiver. staging/xilinx/hdmi/xilinx_drm_hdmi.c implements a
DRM/KMS driver that slaves to xilinx_drm_drv.c in the output pipeline.

If xlnx,vtc-offset is given it specifies the offset of the built-in
VTC IP block. This is required.

Refer to xlnx,vphy.txt for the phy specifics.

retimer-clk is optional. If specified, the corresponding driver
should offer a CCF clock that supports .set_rate(). Through this,
the device can retime/redrive the HDMI TX signal on the connector
depending on the TX clock line rate.

There are 2 optional HDCP cores that can be included in the IP configuration.
Below provided sample device tree depicts the configuration when both cores are 
included. If an optional core is included then corresponding entries for the 
core parameters must be included in the device tree

Note: If HDCP cores are included in the design, the user must provide valid
	  HDCP keys for the encryption to work. 
	  
Required properties:
 - compatible: Should be "xlnx,v-hdmi-tx-ss-2.0".
 - reg: Base address and size of the IP core and hdcp1x key management block
 - reg-names: Identification string for included register blocks
		"hdmi-txss": Identification string for hdmitx subsystem. Always present
		"hdcp1x-keymngmt": Identification string for Key management block for
			hdcp1x. [Optional]

 - interrupts-parent: phandle for interrupt controller.
 - interrupts: Interrupt numbers for mandatory and optional blocks
 - interrupt-names: Identification string that binds irq number to block 
		generating the interrupt
		"hdmitx": interrupt for tx subcore [always present]
		"hdcp1x": interrupt for hdcp1.4 core [optional]
		"hdcp1x-timer": interrupt for hdcp1.4 timer [present if hdcp1x is 
			included]
		"hdcp22": interrupt for hdcp22 core [optional]
		"hdcp22-timer": interrupt for hdcp2.2 timer [present if hdcp22 is
			included]

 - clocks: phandle for axi-lite, video stream and retimer clock
 - clock-names: The identification string, "axi-lite", is always required for
                the axi-lite clock, "video" is always required for video stream
				clock and "retimer-clk" is required only when retimer is being 
				used 
   
 - phys: phandle for phy lanes registered for hdmi protocol. HDMI always 
         require 3 lanes
 - phy-names: The identification string, "hdmi-phy0" and so on
 
  - tx_refclk_rdy_en-gpios: Specifier for a GPIO that is used to over-ride PHY
		tx_refclk_rdy signal from si5324. Polarity should be set to 
		ACTIVE_HIGH(0)

 - xlnx,input-pixels-per-clock: IP configuration for samples/clk (2, 4)
         Note: Only 2 is supported at this time
 - xlnx,max-bits-per-component: The data width per video component (8,10,12,16)
         Note: Only 8 is supported at this time
 - xlnx,hdmi-tx-offset: Relative offset of tx core within the subsystem
 - xlnx,vtc-offset: Relative offset of vtc core within the subsystem
 - xlnx,hdmi-tx-offset: Relative offset of tx core within the subsystem
 - xlnx,hdcp22-tx-offset: Relative offset of optional hdcp22 core within the
		subsystem. If present indicates inclusion of the optional core
 - xlnx,hdcp22-cipher-offset: Relative offset of hdcp22 cipher within the 
		subsystem. Must be present if hdcp22 is included
 - xlnx,hdcp22-timer-offset: Relative offset of hdcp22 timer within the
		subsystem. Must be present if hdcp22 is included
 - xlnx,hdcp22-rng-offset: Relative offset of rng core within the
		subsystem. Must be present if hdcp22 is included	
 - xlnx,hdcp1x-offset: Relative offset of optional hdcp1x core within the
		subsystem. If present indicates inclusion of the optional core 
 - xlnx,hdcp1x-timer-offset: Relative offset of hdcp1x timer within the
		subsystem. Must be present if hdcp1x is included
 - xlnx,hdcp-authenticate: Flag to enable/disable hdcp authentication
 - xlnx,hdcp-encrypt: Flag to enable/disable stream encryption
 
The "retimer-clk" is optional. If present, it is notified of TX link
clock changes through set_rate(). Tested with dp159.c driver.

==Example==

	hdmi_output_v_hdmi_tx_ss_0: v_hdmi_tx_ss@a0020000 {
		compatible = "xlnx,v-hdmi-tx-ss-2.0";
		reg = <0x0 0xa0100000 0x0 0x100000>, <0x0 0xa0280000 0x0 0x10000>;
		reg-names = "hdmi-txss", "hdcp1x-keymngmt";			
		interrupt-parent = <&gic>;
		interrupts = <0 93 4>, <0 104 4>, <0 105 4>, <0 106 4>, <0 107 4>;
		interrupt-names = "hdmitx", "hdcp1x", "hdcp1x-timer", "hdcp22", "hdcp22-timer";
		
		clocks = <&vid_s_axi_clk>, <&vid_stream_clk>, <&dp159>;
		clock-names = "axi-lite", "video", "retimer-clk";
		phy-names = "hdmi-phy0", "hdmi-phy1", "hdmi-phy2";
		phys = <&vphy_lane0 0 1 1 1>, <&vphy_lane1 0 1 1 1>, <&vphy_lane2 0 1 1 1>;
		tx_refclk_rdy_en-gpios = <&gpio 83 0>;
	
		xlnx,input-pixels-per-clock = <0x2>;
		xlnx,max-bits-per-component = <0x8>;
		xlnx,output-fmt = "yuv422";
		xlnx,hdmi-tx-offset = <0x90000>;
		xlnx,vtc-offset = <0xa0000>;
		xlnx,hdcp22-tx-offset = <0x40000>;
		/* relative to xlnx,hdcp22-tx-offset */
		xlnx,hdcp22-cipher-offset = <0x00000>;
		xlnx,hdcp22-timer-offset = <0x10000>;
		xlnx,hdcp22-rng-offset = <0x20000>;
	
		xlnx,hdcp1x-timer-offset = <0x00000>;
		xlnx,hdcp1x-offset = <0x80000>;
	
		/* settings for HDCP */
		xlnx,hdcp-authenticate = <0x0>;
		xlnx,hdcp-encrypt = <0x0>;			
	};
```
